## config/config.in
```kconfig
mainmenu "Helios SDK Configuration"

menu "System Configuration"
source "../system/config.in"
endmenu

menu "EG915UEC_AC"
source "../services/microPython/config/config.in"
endmenu
```

## system/config.in
```kconfig
config MBEDTLS 
    bool "Enable mbedtls" 
    default n 
help 
    This is mbedtls support.
```

## system/platform/Unisoc/boards/EC600UCN_LB/config/config.in
```kconfig
mainmenu "Helios SDK Configuration"

menu "System Configuration"
source "../system/config.in"
endmenu

menu "EC600UCN_LB"
source "../services/microPython/config/config.in"
source "../components/GMSSL/GMSSL.in"
endmenu
```
